## boards/shields/tester_nrf52840/Kconfig.defconfig
```kconfig
if SHIELD_TESTER_NRF52840

config ZMK_KEYBOARD_NAME
    default "ZMKTestNRF52840"

config ZMK_BLE
    def_bool n

config SETTINGS
    def_bool n

endif
```

## boards/shields/tester_nrf52840/Kconfig.shield
```kconfig
config SHIELD_TESTER_NRF52840
    def_bool $(shields_list_contains,tester_nrf52840)
```
